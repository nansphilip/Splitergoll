## boards/shields/splitergoll/Kconfig.defconfig
```kconfig
if SHIELD_SPLITERGOLL_DONGLE || SHIELD_SPLITERGOLL_LEFT || SHIELD_SPLITERGOLL_RIGHT

config ZMK_SPLIT
    default y

endif
```

## boards/shields/splitergoll/Kconfig.shield
```kconfig
config SHIELD_SPLITERGOLL_LEFT
    def_bool $(shields_list_contains,splitergoll_left)

config SHIELD_SPLITERGOLL_RIGHT
    def_bool $(shields_list_contains,splitergoll_right)
```
